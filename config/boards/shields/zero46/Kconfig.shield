## config/boards/shields/zero46/Kconfig.shield
```kconfig
# Copyright (c) 2020 The ZMK Contributors
# SPDX-License-Identifier: MIT

config SHIELD_ZERO46_CENTRAL_DONGLE
    def_bool $(shields_list_contains,zero46_central_dongle)

config SHIELD_ZERO46_CENTRAL_LEFT
    def_bool $(shields_list_contains,zero46_central_left)
    
config SHIELD_ZERO46_PERIPHERAL_LEFT
    def_bool $(shields_list_contains,zero46_peripheral_left)

config SHIELD_ZERO46_PERIPHERAL_RIGHT
    def_bool $(shields_list_contains,zero46_peripheral_right)
```
